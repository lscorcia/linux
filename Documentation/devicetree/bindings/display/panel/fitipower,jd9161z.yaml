## Documentation/devicetree/bindings/display/panel/fitipower,jd9161z.yaml
```yaml
# SPDX-License-Identifier: (GPL-2.0-only OR BSD-2-Clause)
%YAML 1.2
---
$id: http://devicetree.org/schemas/display/panel/fitipower,jd9161z.yaml#
$schema: http://devicetree.org/meta-schemas/core.yaml#

title: Fitipower JD9161Z-based WVGA DSI panels

maintainers:
  - Luca Leonardo Scorcia <l.scorcia@gmail.com>

allOf:
  - $ref: panel-common.yaml#

properties:
  compatible:
    items:
      - enum:
          - zhunyikeji,z40046-ctc
      - const: fitipower,jd9161z

  reg:
    maxItems: 1

  vdd-supply:
    description: supply regulator for VDD, usually 3.3V

  vccio-supply:
    description: supply regulator for VCCIO, usually 1.8V

  reset-gpios: true
  backlight: true
  rotation: true
  port: true

required:
  - compatible
  - reg
  - vdd-supply
  - vccio-supply
  - reset-gpios

additionalProperties: false

examples:
  - |
    #include <dt-bindings/gpio/gpio.h>

    dsi {
        #address-cells = <1>;
        #size-cells = <0>;

        panel@0 {
            compatible = "zhunyikeji,z40046-ctc", "fitipower,jd9161z";
            reg = <0>;
            backlight = <&backlight_lcd>;
            reset-gpios = <&pio 66 GPIO_ACTIVE_LOW>;
            rotation = <270>;
            vccio-supply = <&mt6392_vio28_reg>;
            vdd-supply = <&mt6392_vio18_reg>;

            port {
              panel_in: endpoint {
                remote-endpoint = <&dsi_out>;
              };
            };
        };
    };
...
```

## Documentation/devicetree/bindings/regulator/mediatek,mt6392-regulator.yaml
```yaml
# SPDX-License-Identifier: (GPL-2.0 OR BSD-2-Clause)
%YAML 1.2
---
$id: http://devicetree.org/schemas/regulator/mediatek,mt6392-regulator.yaml#
$schema: http://devicetree.org/meta-schemas/core.yaml#

title: MediaTek MT6392 Regulator

description:
  Regulator node of the PMIC. This node should under the PMIC's device node.
  All voltage regulators provided by the PMIC are described as sub-nodes of
  this node.

patternProperties:
  "^v(core|proc|sys)$":
    description: Buck regulators
    type: object
    $ref: regulator.yaml#
    properties:
      regulator-allowed-modes:
        description: |
          BUCK regulators can set regulator-initial-mode and regulator-allowed-modes to
          values specified in dt-bindings/regulator/mediatek,mt6392-regulator.h
        items:
          enum: [0, 1]
    unevaluatedProperties: false

  "^v(adc18|camio|cn18|io18)$":
    description: LDOs with fixed 1.8V output
    type: object
    $ref: regulator.yaml#
    properties:
      regulator-allowed-modes:
        description: |
          LDO regulators can set regulator-initial-mode and regulator-allowed-modes to
          values specified in dt-bindings/regulator/mediatek,mt6392-regulator.h
        items:
          enum: [0, 1]
    unevaluatedProperties: false

  "^v(xo22)$":
    description: LDOs with fixed 2.2V output
    type: object
    $ref: regulator.yaml#
    properties:
      regulator-allowed-modes:
        description: |
          LDO regulators can set regulator-initial-mode and regulator-allowed-modes to
          values specified in dt-bindings/regulator/mediatek,mt6392-regulator.h
        items:
          enum: [0, 1]
    unevaluatedProperties: false

  "^v(m25)$":
    description: LDOs with fixed 2.5V output
    type: object
    $ref: regulator.yaml#
    properties:
      regulator-allowed-modes:
        description: |
          LDO regulators can set regulator-initial-mode and regulator-allowed-modes to
          values specified in dt-bindings/regulator/mediatek,mt6392-regulator.h
        items:
          enum: [0, 1]
    unevaluatedProperties: false

  "^v(aud28|io28)$":
    description: LDOs with fixed 2.8V output w/ mode
    type: object
    $ref: regulator.yaml#
    properties:
      regulator-allowed-modes:
        description: |
          LDO regulators can set regulator-initial-mode and regulator-allowed-modes to
          values specified in dt-bindings/regulator/mediatek,mt6392-regulator.h
        items:
          enum: [0, 1]
    unevaluatedProperties: false

  "^v(cama)$":
    description: LDOs with fixed 2.8V output w/o mode
    type: object
    $ref: regulator.yaml#
    unevaluatedProperties: false

  "^vusb$":
    description: LDOs with fixed 3.3V output
    type: object
    $ref: regulator.yaml#
    properties:
      regulator-allowed-modes:
        description: |
          LDO regulators can set regulator-initial-mode and regulator-allowed-modes to
          values specified in dt-bindings/regulator/mediatek,mt6392-regulator.h
        items:
          enum: [0, 1]
    unevaluatedProperties: false

  "^v(aud22|camaf|camd|cn35|efuse|emc3v3|gp1|gp2|m|mc|mch)$":
    description: LDOs with variable output
    type: object
    $ref: regulator.yaml#
    properties:
      regulator-allowed-modes: false
    unevaluatedProperties: false

additionalProperties: false
```

## Documentation/devicetree/bindings/sound/mediatek,mt8167-afe-pcm.yaml
```yaml
# SPDX-License-Identifier: (GPL-2.0-only OR BSD-2-Clause)
%YAML 1.2
---
$id: http://devicetree.org/schemas/sound/mediatek,mt8167-afe-pcm.yaml#
$schema: http://devicetree.org/meta-schemas/core.yaml#

title: Mediatek AFE PCM controller for MT8167

maintainers:
  - Luca Leonardo Scorcia <l.scorcia@gmail.com>

properties:
  compatible:
    const: mediatek,mt8167-afe-pcm

  interrupts:
    maxItems: 1

  resets:
    maxItems: 1

  reset-names:
    const: audiosys

  clocks:
    items:
      - description: Audio AFE clock
      - description: Audio I2S input clock
      - description: Audio low-jitter 22.5792m clock
      - description: Audio low-jitter 24.576m clock
      - description: Audio SPDIF-in clock
      - description: Audio PLL2 tuner clock
      - description: Audio PLL1 tuner clock
      - description: Audio HDMI clock
      - description: Audio SPDIF clock
      - description: Audio ADDA ADC clock
      - description: Audio ADDA DAC clock
      - description: Audio ADDA DAC pre-distortion clock
      - description: Audio Test model clock
      - description: audio
      - description: APLL1 and APLL2 divider for I2S port 0
      - description: APLL1 and APLL2 divider for I2S port 1
      - description: APLL1 and APLL2 divider for I2S port 2
      - description: APLL1 and APLL2 divider for I2S port 3
      - description: APLL1 and APLL2 MCK clock divider for I2S port 4
      - description: APLL1 and APLL2 BCK clock divider for I2S port 4
      - description: APLL1 and APLL2 MCK clock divider for I2S port 5
      - description: APLL1 and APLL2 BCK clock divider for I2S port 5
      - description: APLL1 and APLL2 divider for SPDIF
      - description: spdif_in
      - description: Primary audio en-generator clock
      - description: Secondary audio en-generator clock
      - description: Audio 1 clock
      - description: Audio 2 clock
      - description: Mux selector for I2S port 0
      - description: Mux selector for I2S port 1
      - description: Mux selector for I2S port 2
      - description: Mux selector for I2S port 3
      - description: Mux selector for I2S port 4
      - description: Mux selector for I2S port 5
      - description: spdif_b_sel
      - description: spdifin_sel
      - description: univpll_div2

  clock-names:
    items:
      - const: aud_afe
      - const: aud_i2s
      - const: aud_22m
      - const: aud_24m
      - const: aud_intdir
      - const: aud_apll2_tuner
      - const: aud_apll_tuner
      - const: aud_hdmi
      - const: aud_spdf
      - const: aud_adc
      - const: aud_dac
      - const: aud_dac_predis
      - const: aud_tml
      - const: audio
      - const: apll12_div0
      - const: apll12_div1
      - const: apll12_div2
      - const: apll12_div3
      - const: apll12_div4
      - const: apll12_div4b
      - const: apll12_div5
      - const: apll12_div5b
      - const: apll12_div6
      - const: spdif_in
      - const: engen1
      - const: engen2
      - const: aud1
      - const: aud2
      - const: i2s0_m_sel
      - const: i2s1_m_sel
      - const: i2s2_m_sel
      - const: i2s3_m_sel
      - const: i2s4_m_sel
      - const: i2s5_m_sel
      - const: spdif_b_sel
      - const: spdifin_sel
      - const: univpll_div2

required:
  - compatible
  - interrupts
  - resets
  - reset-names
  - clocks
  - clock-names

additionalProperties: false

examples:
  - |
    #include <dt-bindings/clock/mt8167-clk.h>
    #include <dt-bindings/interrupt-controller/arm-gic.h>
    #include <dt-bindings/interrupt-controller/irq.h>
    #include <dt-bindings/power/mt8167-power.h>
    #include <dt-bindings/reset/mediatek,mt8167-resets.h>

    audio-controller {
        compatible = "mediatek,mt8167-afe-pcm";
        interrupts = <GIC_SPI 120 IRQ_TYPE_LEVEL_LOW>;
        resets = <&watchdog MT8167_TOPRGU_AUD_PAD_RST>;
        reset-names = "audiosys";
        clocks = <&audsys CLK_AUD_AFE>,
          <&audsys CLK_AUD_I2S>,
          <&audsys CLK_AUD_22M>,
          <&audsys CLK_AUD_24M>,
          <&audsys CLK_AUD_INTDIR>,
          <&audsys CLK_AUD_APLL2_TUNER>,
          <&audsys CLK_AUD_APLL_TUNER>,
          <&audsys CLK_AUD_HDMI>,
          <&audsys CLK_AUD_SPDF>,
          <&audsys CLK_AUD_ADC>,
          <&audsys CLK_AUD_DAC>,
          <&audsys CLK_AUD_DAC_PREDIS>,
          <&audsys CLK_AUD_TML>,
          <&topckgen CLK_TOP_AUDIO>,
          <&topckgen CLK_TOP_APLL12_DIV0>,
          <&topckgen CLK_TOP_APLL12_DIV1>,
          <&topckgen CLK_TOP_APLL12_DIV2>,
          <&topckgen CLK_TOP_APLL12_DIV3>,
          <&topckgen CLK_TOP_APLL12_DIV4>,
          <&topckgen CLK_TOP_APLL12_DIV4B>,
          <&topckgen CLK_TOP_APLL12_DIV5>,
          <&topckgen CLK_TOP_APLL12_DIV5B>,
          <&topckgen CLK_TOP_APLL12_DIV6>,
          <&topckgen CLK_TOP_RG_AUD_SPDIF_IN>,
          <&topckgen CLK_TOP_RG_AUD_ENGEN1>,
          <&topckgen CLK_TOP_RG_AUD_ENGEN2>,
          <&topckgen CLK_TOP_RG_AUD1>,
          <&topckgen CLK_TOP_RG_AUD2>,
          <&topckgen CLK_TOP_AUD_I2S0_M_SEL>,
          <&topckgen CLK_TOP_AUD_I2S1_M_SEL>,
          <&topckgen CLK_TOP_AUD_I2S2_M_SEL>,
          <&topckgen CLK_TOP_AUD_I2S3_M_SEL>,
          <&topckgen CLK_TOP_AUD_I2S4_M_SEL>,
          <&topckgen CLK_TOP_AUD_I2S5_M_SEL>,
          <&topckgen CLK_TOP_AUD_SPDIF_B_SEL>,
          <&topckgen CLK_TOP_AUD_SPDIFIN_SEL>,
          <&topckgen CLK_TOP_UNIVPLL_D2>;
        clock-names = 
          "aud_afe",
          "aud_i2s",
          "aud_22m",
          "aud_24m",
          "aud_intdir",
          "aud_apll2_tuner",
          "aud_apll_tuner",
          "aud_hdmi",
          "aud_spdf",
          "aud_adc",
          "aud_dac",
          "aud_dac_predis",
          "aud_tml",
          "audio",
          "apll12_div0",
          "apll12_div1",
          "apll12_div2",
          "apll12_div3",
          "apll12_div4",
          "apll12_div4b",
          "apll12_div5",
          "apll12_div5b",
          "apll12_div6",
          "spdif_in",
          "engen1",
          "engen2",
          "aud1",
          "aud2",
          "i2s0_m_sel",
          "i2s1_m_sel",
          "i2s2_m_sel",
          "i2s3_m_sel",
          "i2s4_m_sel",
          "i2s5_m_sel",
          "spdif_b_sel",
          "spdifin_sel",
          "univpll_div2";
        assigned-clocks = <&topckgen CLK_TOP_AUD1_SEL>,
          <&topckgen CLK_TOP_AUD2_SEL>,
          <&topckgen CLK_TOP_AUD_ENGEN1_SEL>,
          <&topckgen CLK_TOP_AUD_ENGEN2_SEL>;
        assigned-clock-parents = <&topckgen CLK_TOP_APLL1>,
          <&topckgen CLK_TOP_APLL2>,
          <&topckgen CLK_TOP_RG_APLL1_D8_EN>,
          <&topckgen CLK_TOP_RG_APLL2_D8_EN>;
    };
```

## Documentation/devicetree/bindings/sound/mediatek,mt8516-afe-pcm.yaml
```yaml
# SPDX-License-Identifier: (GPL-2.0-only OR BSD-2-Clause)
%YAML 1.2
---
$id: http://devicetree.org/schemas/sound/mediatek,mt8516-afe-pcm.yaml#
$schema: http://devicetree.org/meta-schemas/core.yaml#

title: Mediatek AFE PCM controller for MT8516

maintainers:
  - Luca Leonardo Scorcia <l.scorcia@gmail.com>

properties:
  compatible:
    const: mediatek,mt8516-afe-pcm

  reg:
    maxItems: 1

  interrupts:
    maxItems: 1

  clocks:
    items:
      - description: Audio top mux
      - description: ADDA DAC clock
      - description: ADDA DAC pre-distortion clock
      - description: ADDA ADC clock

  clock-names:
    items:
      - const: top_pdn_audio
      - const: aud_dac_clk
      - const: aud_dac_predis_clk
      - const: aud_adc_clk

required:
  - compatible
  - reg
  - interrupts
  - clocks
  - clock-names

additionalProperties: false

examples:
  - |
    #include <dt-bindings/clock/mt8516-clk.h>
    #include <dt-bindings/interrupt-controller/arm-gic.h>
    #include <dt-bindings/interrupt-controller/irq.h>

    afe: mt8516-afe-pcm@11140000 {
      compatible = "mediatek,mt8516-afe-pcm";
      reg = <0x11140000 0x1000>;
      interrupts = <GIC_SPI 120 IRQ_TYPE_LEVEL_LOW>;
      clocks = <&topckgen CLK_TOP_AUDIO>,
               <&audiotop CLK_AUD_DAC>,
               <&audiotop CLK_AUD_DAC_PREDIS>,
               <&audiotop CLK_AUD_ADC>;
      clock-names = "top_pdn_audio",
                    "aud_dac_clk",
                    "aud_dac_predis_clk",
                    "aud_adc_clk";
    };
```

## drivers/misc/mediatek/Kconfig
```kconfig
menuconfig MEDIATEK_SOLUTION
	bool "MediaTek Properitary Configuration"
	select FW_LOADER_USER_HELPER_FALLBACK
	select I2C
	help
	  Check this to enable MediaTek properity configuration.

if MEDIATEK_SOLUTION

config MTK_PLATFORM
	string "MTK platform name"

config ARCH_MTK_PROJECT
	string "MTK project name"

menu "Modem & Connectivity related configs"

#source "drivers/misc/mediatek/btcvsd/Kconfig"
source "drivers/misc/mediatek/btif/Kconfig"
#source "drivers/misc/mediatek/ccci_util/Kconfig"
#source "drivers/misc/mediatek/ccmni/Kconfig"
source "drivers/misc/mediatek/connectivity/Kconfig"
#source "drivers/misc/mediatek/conn_md/Kconfig"
#source "drivers/misc/mediatek/dual_ccci/Kconfig"
#source "drivers/misc/mediatek/eccci/Kconfig"
#source "drivers/misc/mediatek/nfc/Kconfig"
#source "drivers/misc/mediatek/ssw/Kconfig"

config MTK_VOLTE_SUPPORT
	bool
	default n
	depends on !CRYPTO_NULL || !CRYPTO_SHA512 || !CRYPTO_XCBC || !CRYPTO_CTR
	help
	  dummy option for dependency check.if MTK_VOLTE_SUPPORT is set,
	  CRYPTO_NULL && CRYPTO_SHA512 && CRYPTO_XCBC are not set, build error will happen.
	  CRYPTO_NULL && CRYPTO_SHA512 && CRYPTO_XCBC are set, build error will be fixed; when
	  MTK_VOLTE_SUPPORT is not set, there is no error whatever CRYPTO_NULL or CRYPTO_SHA512
	  or CRYPTO_XCBC are set or not

config MTK_EPDG_SUPPORT
	bool
	default n
	depends on !XFRM_USER || !XFRM_SUB_POLICY
	help
	  dummy option for dependency check.if MTK_EPDG_SUPPORT is set,
	  XFRM_USER && XFRM_SUB_POLICY  are not set, build error will happen.  XFRM_USER &&
	  XFRM_SUB_POLICY are set, build error will be fixed; when MTK_EPDG_SUPPORT is not
	  set, there is no error whatever XFRM_USER && XFRM_SUB_POLICY  are set or not


endmenu  # CONN

endif
```
